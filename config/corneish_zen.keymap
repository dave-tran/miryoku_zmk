// Copyright 2022 Manna Harbour
// https://github.com/manna-harbour/miryoku


#include "../miryoku/custom_config.h"
#include "../miryoku/mapping/42/corne.h"
#include "../miryoku/miryoku.dtsi"

/ {
  chosen {
    zmk,matrix_transform = &default_transform;
  };
};

/ {
  macros {
  my_macro: my_macro {
    compatible = "zmk,behavior-macro";
    label = "ZM_my_macro";
          wait-ms = <30>;
          tap-ms = <40>;
          #binding-cells = <0>;
          bindings = <&kp A>, <&kp AT>, <&kp B>, <&kp C>, <&kp RET> ;
          };
  };
};
